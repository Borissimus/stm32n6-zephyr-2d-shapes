## CMakeLists.txt
```
cmake_minimum_required(VERSION 3.20.0)

find_package(Zephyr REQUIRED HINTS $ENV{ZEPHYR_BASE})
project(stm32n6_zephyr_2d_shapes)

target_compile_definitions(app PRIVATE
  USE_HAL_DRIVER
  APP_HAS_PARALLEL_NETWORKS=0
  LL_ATON_PLATFORM=LL_ATON_PLAT_STM32N6
  LL_ATON_OSAL=LL_ATON_OSAL_ZEPHYR
  LL_ATON_SW_FALLBACK=1
  LL_ATON_DBG_BUFFER_INFO_EXCLUDED=1
)

target_include_directories(app PRIVATE
  include
  ai/inc
  ai/ll_aton
  ai/shapes_mobilenet_v2
  ai/device_stm32n6
  bsp/STM32N6570-DK
  bsp/Components/aps256xx
  bsp/Components/mx66uw1g45g
)

target_sources(app PRIVATE
  src/main.c
  src/shapes_uart_transport.c
  src/heartbeat.c
  src/shapes_classifier.c
  src/stm32n6_external_flash.c
  src/stm32n6_npu_preinit.c
  ai/shapes_mobilenet_v2/shapes_mobilenet_v2.c
  ai/shapes_mobilenet_v2/stai_shapes_mobilenet_v2.c
  ai/device_stm32n6/mcu_cache.c
  ai/device_stm32n6/npu_cache.c
  ai/ll_aton/ll_aton.c
  ai/ll_aton/ll_aton_cipher.c
  ai/ll_aton/ll_aton_lib.c
  ai/ll_aton/ll_aton_lib_sw_operators.c
  ai/ll_aton/ll_aton_osal_zephyr.c
  ai/ll_aton/ll_aton_runtime.c
  ai/ll_aton/ll_aton_stai_internal.c
  ai/ll_aton/ll_aton_util.c
  ai/ll_aton/ll_sw_float.c
  ai/ll_aton/ll_sw_integer.c
  bsp/STM32N6570-DK/stm32n6570_discovery_xspi.c
  bsp/Components/aps256xx/aps256xx.c
  bsp/Components/mx66uw1g45g/mx66uw1g45g.c
  ${ZEPHYR_BASE}/../modules/hal/stm32/stm32cube/stm32n6xx/drivers/src/stm32n6xx_hal_gpio.c
  ${ZEPHYR_BASE}/../modules/hal/stm32/stm32cube/stm32n6xx/drivers/src/stm32n6xx_hal_pwr.c
  ${ZEPHYR_BASE}/../modules/hal/stm32/stm32cube/stm32n6xx/drivers/src/stm32n6xx_hal_pwr_ex.c
)

target_link_libraries(app PRIVATE
  ${CMAKE_CURRENT_SOURCE_DIR}/ai/lib/NetworkRuntime1201_CM55_GCC.a
  m
)
```

## west.yml
```
manifest:
  version: "0.13"

  remotes:
    - name: zephyrproject-rtos
      url-base: https://github.com/zephyrproject-rtos

  projects:
    - name: zephyr
      remote: zephyrproject-rtos
      revision: v4.4.0
      import: true

    # ST ISP glue and middleware for the STM32N6 DCMIPP pixel pipeline.
    - name: zephyr-stm32-mw-isp
      url: https://github.com/stm32-hotspot/zephyr-stm32-mw-isp.git
      revision: 4540e611e64dc04e82881f40999a26b34c54b71e
      path: st/lib/zephyr-stm32-mw-isp
      submodules: true

  self:
    path: app
```

## prj.conf
```kconfig
CONFIG_STDOUT_CONSOLE=y
CONFIG_SERIAL=y
CONFIG_UART_CONSOLE=y
CONFIG_CONSOLE=y
CONFIG_PRINTK=y
CONFIG_GPIO=y
CONFIG_LOG=y
CONFIG_LOG_DEFAULT_LEVEL=3
CONFIG_LOG_MODE_DEFERRED=y
CONFIG_LOG_PROCESS_THREAD_STACK_SIZE=4096
CONFIG_LOG_BUFFER_SIZE=8192
CONFIG_LOG_BACKEND_UART_BUFFER_SIZE=512
CONFIG_LOG_BACKEND_SHOW_COLOR=n
CONFIG_SIZE_OPTIMIZATIONS_AGGRESSIVE=y
CONFIG_MAIN_STACK_SIZE=8192
CONFIG_HEAP_MEM_POOL_SIZE=32768
CONFIG_UART_INTERRUPT_DRIVEN=y
CONFIG_RING_BUFFER_LARGE=y
CONFIG_DYNAMIC_INTERRUPTS=y
CONFIG_FPU=y
CONFIG_FP_HARDABI=y
CONFIG_CRC=y
CONFIG_STM32N6_NPU=y
```

## app.overlay
```dts
&usart1 {
	current-speed = <1000000>;
	fifo-enable;
};

&npu {
	status = "okay";
};

&npu_cache {
	status = "okay";
};
```

## src/main.c
```c
#include <stdbool.h>
#include <stdint.h>
#include <string.h>

#include <zephyr/device.h>
#include <zephyr/kernel.h>
#include <zephyr/kernel_version.h>
#include <zephyr/sys/printk.h>

#include "embedded_self_test_images.h"
#include "heartbeat.h"
#include "shapes_classifier.h"
#include "shapes_uart_transport.h"

static const struct device *const console_uart = DEVICE_DT_GET(DT_CHOSEN(zephyr_console));
static uint8_t image_bytes[SHAPES_IMAGE_BYTES] __aligned(32);

static uint8_t expand_rgb5(uint16_t value)
{
	return (uint8_t)((value << 3) | (value >> 2));
}

static uint8_t expand_rgb6(uint16_t value)
{
	return (uint8_t)((value << 2) | (value >> 4));
}

static void rgb565_to_rgb888_hwc(const uint16_t *rgb565, uint8_t *rgb888)
{
	for (size_t index = 0; index < SHAPES_IMAGE_WIDTH * SHAPES_IMAGE_HEIGHT; ++index) {
		uint16_t pixel = rgb565[index];
		size_t output = index * SHAPES_IMAGE_CHANNELS;

		rgb888[output] = expand_rgb5((pixel >> 11) & 0x1fU);
		rgb888[output + 1U] = expand_rgb6((pixel >> 5) & 0x3fU);
		rgb888[output + 2U] = expand_rgb5(pixel & 0x1fU);
	}
}

static void run_embedded_self_test(void)
{
	uint32_t correct = 0U;

	printk("SELFTEST begin count=%u\n", (unsigned int)EMBEDDED_SELF_TEST_CASE_COUNT);
	for (size_t index = 0; index < EMBEDDED_SELF_TEST_CASE_COUNT; ++index) {
		const embedded_self_test_case_t *test_case = &embedded_self_test_cases[index];
		struct shapes_result result;
		int rc;

		rgb565_to_rgb888_hwc(test_case->rgb565_data, image_bytes);
		rc = shapes_classifier_run_rgb888_hwc(image_bytes, &result);
		bool match = rc == 0 && strcmp(shapes_classifier_label(result.index), test_case->label) == 0;

		correct += match ? 1U : 0U;
		printk("SELFTEST case=%u expected=%s predicted=%s status=%s time_us=%u\n",
		       (unsigned int)index, test_case->label,
		       rc == 0 ? shapes_classifier_label(result.index) : "error",
		       match ? "ok" : "fail", rc == 0 ? result.inference_us : 0U);
	}
	printk("SELFTEST summary correct=%u total=%u\n", correct,
	       (unsigned int)EMBEDDED_SELF_TEST_CASE_COUNT);
}

int main(void)
{
	uint32_t version = sys_kernel_version_get();

	printk("stm32n6-zephyr-2d-shapes: boot\n");
	printk("kernel version: %u.%u.%u\n", SYS_KERNEL_VER_MAJOR(version),
	       SYS_KERNEL_VER_MINOR(version), SYS_KERNEL_VER_PATCHLEVEL(version));
	if (heartbeat_start() < 0 || shapes_classifier_init() < 0) {
		return -1;
	}
	if (shapes_uart_transport_init(console_uart, image_bytes, sizeof(image_bytes),
				      run_embedded_self_test) < 0) {
		return -1;
	}
	printk("Shapes2D ready: COBS v1, 27 x 1024 B, CRC32 frame; TST0 self-test\n");
	run_embedded_self_test();
	printk("Waiting for COBS image frames...\n");
	shapes_uart_transport_run();
	return 0;
}
```

## include/heartbeat.h
```c
#ifndef STM32N6_ZEPHYR_AI_APP_HEARTBEAT_H_
#define STM32N6_ZEPHYR_AI_APP_HEARTBEAT_H_

int heartbeat_start(void);

#endif /* STM32N6_ZEPHYR_AI_APP_HEARTBEAT_H_ */
```

## include/shapes_classifier.h
```c
#ifndef STM32N6_SHAPES_CLASSIFIER_H_
#define STM32N6_SHAPES_CLASSIFIER_H_

#include <stdint.h>

#define SHAPES_IMAGE_WIDTH 96U
#define SHAPES_IMAGE_HEIGHT 96U
#define SHAPES_IMAGE_CHANNELS 3U
#define SHAPES_IMAGE_BYTES (SHAPES_IMAGE_WIDTH * SHAPES_IMAGE_HEIGHT * SHAPES_IMAGE_CHANNELS)
#define SHAPES_CLASS_COUNT 3U

struct shapes_result {
	uint32_t index;
	float scores[SHAPES_CLASS_COUNT];
	uint32_t preprocess_us;
	uint32_t inference_us;
};

int shapes_classifier_init(void);
int shapes_classifier_run_rgb888_hwc(const uint8_t *rgb, struct shapes_result *result);
const char *shapes_classifier_label(uint32_t index);

#endif /* STM32N6_SHAPES_CLASSIFIER_H_ */
```

## include/shapes_uart_transport.h
```c
#ifndef STM32N6_SHAPES_UART_TRANSPORT_H_
#define STM32N6_SHAPES_UART_TRANSPORT_H_

#include <stddef.h>
#include <stdint.h>

struct device;

typedef void (*shapes_uart_self_test_fn)(void);

int shapes_uart_transport_init(const struct device *uart, uint8_t *image_buffer,
			       size_t image_buffer_size, shapes_uart_self_test_fn self_test);
void shapes_uart_transport_run(void);

#endif /* STM32N6_SHAPES_UART_TRANSPORT_H_ */
```

## include/stm32n6_external_flash.h
```c
#ifndef STM32N6_EXTERNAL_FLASH_H
#define STM32N6_EXTERNAL_FLASH_H

#include <stddef.h>
#include <stdint.h>

#define STM32N6_NOR_BASE_ADDR      0x70000000UL
#define STM32N6_NOR_TEST_ABS_ADDR  0x71800000UL
#define STM32N6_NOR_TEST_BLOCK_LEN (64U * 1024U)
#define STM32N6_NOR_TEST_DATA_LEN  256U

struct stm32n6_nor_test_result {
	uint32_t abs_addr;
	uint32_t offset;
	uint32_t size;
	int erase_rc;
	int write_rc;
	int read_rc;
	int auto_poll_rc;
	int write_enable_erase_rc;
	int block_erase_rc;
	int auto_poll_after_erase_rc;
	int write_enable_program_rc;
	int page_program_rc;
	int auto_poll_after_program_rc;
	int direct_read_rc;
	uint32_t expected_crc32;
	uint32_t actual_crc32;
	uint32_t mismatch_count;
	uint32_t first_bad_offset;
};

int stm32n6_external_flash_init(void);
int stm32n6_external_flash_read(uint32_t abs_addr, uint8_t *buf, size_t len);
/* A write session temporarily switches XSPI2 from memory-mapped to indirect
 * mode. The caller must ensure no NPU inference is using NOR-backed weights. */
int stm32n6_external_flash_begin_write(void);
int stm32n6_external_flash_erase_64k(uint32_t abs_addr);
int stm32n6_external_flash_write(uint32_t abs_addr, const uint8_t *buf, size_t len);
int stm32n6_external_flash_read_indirect(uint32_t abs_addr, uint8_t *buf, size_t len);
int stm32n6_external_flash_end_write(void);
int stm32n6_external_flash_nor_test(struct stm32n6_nor_test_result *result);

#endif
```

## include/stm32n6_npu_preinit.h
```c
#ifndef STM32N6_NPU_PREINIT_H_
#define STM32N6_NPU_PREINIT_H_

int stm32n6_xspi_pre_init(void);
int stm32n6_npu_pre_init(void);

#endif /* STM32N6_NPU_PREINIT_H_ */
```

## src/heartbeat.c
```c
#include <stdbool.h>
#include <errno.h>

#include <zephyr/device.h>
#include <zephyr/drivers/gpio.h>
#include <zephyr/kernel.h>
#include <zephyr/logging/log.h>
#include "heartbeat.h"

LOG_MODULE_REGISTER(heartbeat, LOG_LEVEL_INF);

#define HEARTBEAT_STACK_SIZE 768
#define HEARTBEAT_PRIORITY 7
#define HEARTBEAT_PERIOD K_MSEC(500)

static const struct gpio_dt_spec heartbeat_led = GPIO_DT_SPEC_GET(DT_ALIAS(led0), gpios);

static struct k_thread heartbeat_thread_data;
static K_THREAD_STACK_DEFINE(heartbeat_thread_stack, HEARTBEAT_STACK_SIZE);
static struct k_sem heartbeat_start_sem;

static void heartbeat_thread(void *arg1, void *arg2, void *arg3)
{
	ARG_UNUSED(arg1);
	ARG_UNUSED(arg2);
	ARG_UNUSED(arg3);
	k_sem_take(&heartbeat_start_sem, K_FOREVER);

	LOG_DBG("heartbeat thread running on %s", heartbeat_led.port->name);

	while (1) {
		gpio_pin_toggle_dt(&heartbeat_led);
		k_sleep(HEARTBEAT_PERIOD);
	}
}

int heartbeat_start(void)
{
	static bool initialized;
	static bool started;
	int ret;

	if (!gpio_is_ready_dt(&heartbeat_led)) {
		LOG_ERR("heartbeat LED device is not ready");
		return -ENODEV;
	}

	ret = gpio_pin_configure_dt(&heartbeat_led, GPIO_OUTPUT_INACTIVE);
	if (ret < 0) {
		LOG_ERR("failed to configure heartbeat LED: %d", ret);
		return ret;
	}

	if (!initialized) {
		k_sem_init(&heartbeat_start_sem, 0, 1);

		k_thread_create(&heartbeat_thread_data,
			       heartbeat_thread_stack,
			       K_THREAD_STACK_SIZEOF(heartbeat_thread_stack),
			       heartbeat_thread,
			       NULL, NULL, NULL,
			       HEARTBEAT_PRIORITY,
			       0,
			       K_NO_WAIT);
		k_thread_name_set(&heartbeat_thread_data, "heartbeat");
		initialized = true;
	}

	if (started) {
		return 0;
	}

	k_sem_give(&heartbeat_start_sem);
	started = true;
	LOG_DBG("heartbeat started using led0");

	return 0;
}
```

## src/shapes_classifier.c
```c
#include <errno.h>
#include <limits.h>
#include <stdint.h>

#include <zephyr/kernel.h>
#include <zephyr/logging/log.h>

#include "stai.h"
#include "stai_shapes_mobilenet_v2.h"
#include "ll_aton_NN_interface.h"

#include "shapes_classifier.h"
#include "stm32n6_npu_preinit.h"

LOG_MODULE_REGISTER(shapes_classifier, LOG_LEVEL_INF);

#define SHAPES_INPUT_SCALE_NUM 127
#define SHAPES_INPUT_SCALE_DEN 255
#define SHAPES_OUTPUT_SCALE 0.0954789146780968f

STAI_NETWORK_CONTEXT_DECLARE(g_network_ctx, STAI_SHAPES_MOBILENET_V2_CONTEXT_SIZE);

static int8_t *g_model_input;
static int8_t *g_model_output;
static bool g_ready;

static const char *const g_labels[SHAPES_CLASS_COUNT] = {
	"circle",
	"square",
	"triangle",
};

static int8_t quantize_rgb_component(uint8_t value)
{
	/* QDQ input: ((rgb / 255.0) - 0.5) / 0.5, scale=1/127, zero=0. */
	int32_t quantized = ((int32_t)value * 2 * SHAPES_INPUT_SCALE_NUM +
			     SHAPES_INPUT_SCALE_DEN / 2) /
			    SHAPES_INPUT_SCALE_DEN - SHAPES_INPUT_SCALE_NUM;

	if (quantized > INT8_MAX) {
		return INT8_MAX;
	}
	if (quantized < INT8_MIN) {
		return INT8_MIN;
	}
	return (int8_t)quantized;
}

int shapes_classifier_init(void)
{
	stai_ptr inputs[STAI_SHAPES_MOBILENET_V2_IN_NUM];
	stai_ptr outputs[STAI_SHAPES_MOBILENET_V2_OUT_NUM];
	stai_size input_count = 0U;
	stai_size output_count = 0U;
	stai_return_code rc;

	if (g_ready) {
		return 0;
	}

	/* RAM-load images do not inherit MCUboot's XSPI2 mapping. */
	if (!IS_ENABLED(CONFIG_XIP) && stm32n6_xspi_pre_init() != 0) {
		LOG_ERR("xSPI NOR memory-map init failed");
		return -EIO;
	}
	if (stm32n6_npu_pre_init() != 0) {
		LOG_ERR("NPU platform pre-init failed");
		return -EIO;
	}
	if (stai_runtime_init() != STAI_SUCCESS) {
		LOG_ERR("STAI runtime init failed");
		return -EIO;
	}

	rc = stai_shapes_mobilenet_v2_init(g_network_ctx);
	if (rc != STAI_SUCCESS) {
		LOG_ERR("Shape model init failed: 0x%x", rc);
		return -EIO;
	}
	rc = stai_shapes_mobilenet_v2_get_inputs(g_network_ctx, inputs, &input_count);
	if (rc != STAI_SUCCESS || input_count != STAI_SHAPES_MOBILENET_V2_IN_NUM) {
		LOG_ERR("Shape model input query failed: rc=0x%x count=%u", rc,
			(unsigned int)input_count);
		return -EIO;
	}
	rc = stai_shapes_mobilenet_v2_get_outputs(g_network_ctx, outputs, &output_count);
	if (rc != STAI_SUCCESS || output_count != STAI_SHAPES_MOBILENET_V2_OUT_NUM) {
		LOG_ERR("Shape model output query failed: rc=0x%x count=%u", rc,
			(unsigned int)output_count);
		return -EIO;
	}

	g_model_input = (int8_t *)inputs[0];
	g_model_output = (int8_t *)outputs[0];
	g_ready = true;
	LOG_INF("Shapes model ready: input=%u bytes output=%u bytes weights=0x71000000",
		(unsigned int)SHAPES_IMAGE_BYTES, (unsigned int)SHAPES_CLASS_COUNT);
	return 0;
}

int shapes_classifier_run_rgb888_hwc(const uint8_t *rgb, struct shapes_result *result)
{
	const size_t plane_size = SHAPES_IMAGE_WIDTH * SHAPES_IMAGE_HEIGHT;
	uint32_t start_cycles;
	stai_return_code rc;

	if (!g_ready || rgb == NULL || result == NULL) {
		return -EINVAL;
	}

	start_cycles = k_cycle_get_32();
	for (size_t index = 0; index < plane_size; ++index) {
		const size_t source = index * SHAPES_IMAGE_CHANNELS;

		g_model_input[index] = quantize_rgb_component(rgb[source]);
		g_model_input[plane_size + index] = quantize_rgb_component(rgb[source + 1U]);
		g_model_input[(2U * plane_size) + index] = quantize_rgb_component(rgb[source + 2U]);
	}
	result->preprocess_us = k_cyc_to_us_floor32(k_cycle_get_32() - start_cycles);

	start_cycles = k_cycle_get_32();
	rc = stai_shapes_mobilenet_v2_run(g_network_ctx, STAI_MODE_SYNC);
	result->inference_us = k_cyc_to_us_floor32(k_cycle_get_32() - start_cycles);
	if (rc != STAI_SUCCESS) {
		LOG_ERR("Shape inference failed: 0x%x", rc);
		return -EIO;
	}

	result->index = 0U;
	for (size_t index = 0; index < SHAPES_CLASS_COUNT; ++index) {
		result->scores[index] = (float)g_model_output[index] * SHAPES_OUTPUT_SCALE;
		if (result->scores[index] > result->scores[result->index]) {
			result->index = index;
		}
	}
	return 0;
}

const char *shapes_classifier_label(uint32_t index)
{
	return index < SHAPES_CLASS_COUNT ? g_labels[index] : "invalid";
}
```

## src/shapes_uart_transport.c
```c
#include <errno.h>
#include <stdbool.h>
#include <stddef.h>
#include <stdint.h>
#include <string.h>

#include <zephyr/device.h>
#include <zephyr/drivers/uart.h>
#include <zephyr/kernel.h>
#include <zephyr/sys/byteorder.h>
#include <zephyr/sys/crc.h>
#include <zephyr/sys/ring_buffer.h>

#include "shapes_classifier.h"
#include "shapes_uart_transport.h"

#define SHAPES_PROTOCOL_VERSION 1U
#define SHAPES_CHUNK_SIZE 1024U
#define SHAPES_CHUNK_COUNT (SHAPES_IMAGE_BYTES / SHAPES_CHUNK_SIZE)
#define SHAPES_START_BYTES 14U
#define SHAPES_DATA_HEADER_BYTES 8U
#define SHAPES_DATA_BYTES (SHAPES_DATA_HEADER_BYTES + SHAPES_CHUNK_SIZE)
#define SHAPES_MAX_PACKET_BYTES SHAPES_DATA_BYTES
#define SHAPES_MAX_ENCODED_BYTES (SHAPES_MAX_PACKET_BYTES + (SHAPES_MAX_PACKET_BYTES / 254U) + 2U)
#define SHAPES_RX_RING_BYTES 2048U
#define SHAPES_SESSION_TIMEOUT_MS 1000

enum shapes_packet_type {
	SHAPES_PACKET_START = 1U,
	SHAPES_PACKET_DATA = 2U,
	SHAPES_PACKET_ABORT = 3U,
	SHAPES_PACKET_ACK_START = 0x81U,
	SHAPES_PACKET_ACK_DATA = 0x82U,
	SHAPES_PACKET_NACK = 0x83U,
	SHAPES_PACKET_RESULT = 0x84U,
};

enum shapes_nack_reason {
	SHAPES_NACK_FRAME = 1U,
	SHAPES_NACK_VERSION = 2U,
	SHAPES_NACK_START = 3U,
	SHAPES_NACK_SESSION = 4U,
	SHAPES_NACK_SEQUENCE = 5U,
	SHAPES_NACK_TIMEOUT = 6U,
	SHAPES_NACK_CRC = 7U,
	SHAPES_NACK_ABORTED = 8U,
};

struct shapes_session {
	bool active;
	uint32_t id;
	uint32_t expected_crc;
	uint16_t next_sequence;
	int64_t deadline_ms;
};

RING_BUF_DECLARE(g_rx_ring, SHAPES_RX_RING_BYTES);
K_SEM_DEFINE(g_rx_ready, 0, 1);

static const struct device *g_uart;
static uint8_t *g_image_buffer;
static shapes_uart_self_test_fn g_self_test;
static struct shapes_session g_session;
static uint8_t g_encoded_packet[SHAPES_MAX_ENCODED_BYTES];
static size_t g_encoded_length;
static bool g_drop_until_delimiter;
static volatile uint32_t g_rx_dropped;
static uint32_t g_rx_dropped_seen;

static size_t cobs_encode(const uint8_t *input, size_t input_length, uint8_t *output,
			  size_t output_capacity)
{
	size_t read = 0U;
	size_t write = 1U;
	size_t code_index = 0U;
	uint8_t code = 1U;

	if (output_capacity == 0U) {
		return 0U;
	}
	while (read < input_length) {
		if (write >= output_capacity) {
			return 0U;
		}
		if (input[read] == 0U) {
			output[code_index] = code;
			code_index = write++;
			code = 1U;
		} else {
			output[write++] = input[read];
			if (++code == 0xffU) {
				if (write >= output_capacity) {
					return 0U;
				}
				output[code_index] = code;
				code_index = write++;
				code = 1U;
			}
		}
		++read;
	}
	output[code_index] = code;
	return write;
}

static size_t cobs_decode(const uint8_t *input, size_t input_length, uint8_t *output,
			  size_t output_capacity)
{
	size_t read = 0U;
	size_t write = 0U;

	while (read < input_length) {
		uint8_t code = input[read++];

		if (code == 0U || (size_t)(code - 1U) > input_length - read) {
			return 0U;
		}
		if (write + (size_t)(code - 1U) > output_capacity) {
			return 0U;
		}
		for (uint8_t index = 1U; index < code; ++index) {
			output[write++] = input[read++];
		}
		if (code != 0xffU && read < input_length) {
			if (write >= output_capacity) {
				return 0U;
			}
			output[write++] = 0U;
		}
	}
	return write;
}

static void send_raw_packet(const uint8_t *packet, size_t packet_length)
{
	uint8_t encoded[64];
	size_t encoded_length = cobs_encode(packet, packet_length, encoded, sizeof(encoded));

	if (encoded_length == 0U) {
		return;
	}
	for (size_t index = 0U; index < encoded_length; ++index) {
		uart_poll_out(g_uart, encoded[index]);
	}
	uart_poll_out(g_uart, 0U);
}

static void send_ack(uint8_t type, uint32_t session_id, uint16_t sequence)
{
	uint8_t packet[8] = { SHAPES_PROTOCOL_VERSION, type };

	sys_put_le32(session_id, &packet[2]);
	if (type == SHAPES_PACKET_ACK_DATA) {
		sys_put_le16(sequence, &packet[6]);
		send_raw_packet(packet, sizeof(packet));
	} else {
		send_raw_packet(packet, 6U);
	}
}

static void send_nack(uint32_t session_id, uint8_t reason, uint16_t expected_sequence)
{
	uint8_t packet[10] = { SHAPES_PROTOCOL_VERSION, SHAPES_PACKET_NACK };

	sys_put_le32(session_id, &packet[2]);
	packet[6] = reason;
	sys_put_le16(expected_sequence, &packet[7]);
	send_raw_packet(packet, 9U);
}

static void send_result(uint32_t session_id, const struct shapes_result *result, int rc)
{
	uint8_t packet[19] = { SHAPES_PROTOCOL_VERSION, SHAPES_PACKET_RESULT };

	sys_put_le32(session_id, &packet[2]);
	packet[6] = rc == 0 ? 0U : 1U;
	packet[7] = rc == 0 ? (uint8_t)result->index : 0xffU;
	sys_put_le32(rc == 0 ? result->inference_us : 0U, &packet[8]);
	sys_put_le32(rc == 0 ? result->preprocess_us : 0U, &packet[12]);
	if (rc == 0) {
		for (size_t index = 0U; index < SHAPES_CLASS_COUNT; ++index) {
			packet[16U + index] = (uint8_t)((int8_t)(result->scores[index] / 0.0954789146780968f));
		}
	}
	send_raw_packet(packet, sizeof(packet));
}

static void reset_session(void)
{
	memset(&g_session, 0, sizeof(g_session));
}

static void refresh_session_deadline(void)
{
	g_session.deadline_ms = k_uptime_get() + SHAPES_SESSION_TIMEOUT_MS;
}

static void handle_start(const uint8_t *packet, size_t packet_length)
{
	uint32_t session_id;
	uint32_t total_size;

	if (packet_length != SHAPES_START_BYTES) {
		send_nack(0U, SHAPES_NACK_START, 0U);
		return;
	}
	session_id = sys_get_le32(&packet[2]);
	total_size = sys_get_le32(&packet[6]);
	if (session_id == 0U || total_size != SHAPES_IMAGE_BYTES) {
		send_nack(session_id, SHAPES_NACK_START, 0U);
		return;
	}
	if (g_session.active && g_session.id == session_id && g_session.next_sequence == 0U) {
		send_ack(SHAPES_PACKET_ACK_START, session_id, 0U);
		return;
	}
	g_session.active = true;
	g_session.id = session_id;
	g_session.expected_crc = sys_get_le32(&packet[10]);
	g_session.next_sequence = 0U;
	refresh_session_deadline();
	send_ack(SHAPES_PACKET_ACK_START, session_id, 0U);
}

static void complete_image(void)
{
	struct shapes_result result;
	uint32_t session_id = g_session.id;
	int rc;

	if (crc32_ieee(g_image_buffer, SHAPES_IMAGE_BYTES) != g_session.expected_crc) {
		send_nack(session_id, SHAPES_NACK_CRC, SHAPES_CHUNK_COUNT);
		reset_session();
		return;
	}
	rc = shapes_classifier_run_rgb888_hwc(g_image_buffer, &result);
	reset_session();
	send_result(session_id, &result, rc);
}

static void handle_data(const uint8_t *packet, size_t packet_length)
{
	uint32_t session_id;
	uint16_t sequence;

	if (packet_length != SHAPES_DATA_BYTES) {
		send_nack(g_session.active ? g_session.id : 0U, SHAPES_NACK_FRAME,
			  g_session.next_sequence);
		return;
	}
	session_id = sys_get_le32(&packet[2]);
	sequence = sys_get_le16(&packet[6]);
	if (!g_session.active || session_id != g_session.id) {
		send_nack(session_id, SHAPES_NACK_SESSION,
			  g_session.active ? g_session.next_sequence : 0U);
		return;
	}
	if (sequence + 1U == g_session.next_sequence) {
		send_ack(SHAPES_PACKET_ACK_DATA, session_id, sequence);
		return;
	}
	if (sequence != g_session.next_sequence || sequence >= SHAPES_CHUNK_COUNT) {
		send_nack(session_id, SHAPES_NACK_SEQUENCE, g_session.next_sequence);
		return;
	}
	memcpy(&g_image_buffer[(size_t)sequence * SHAPES_CHUNK_SIZE],
	       &packet[SHAPES_DATA_HEADER_BYTES], SHAPES_CHUNK_SIZE);
	++g_session.next_sequence;
	refresh_session_deadline();
	if (g_session.next_sequence == SHAPES_CHUNK_COUNT) {
		complete_image();
		return;
	}
	send_ack(SHAPES_PACKET_ACK_DATA, session_id, sequence);
}

static void handle_packet(const uint8_t *packet, size_t packet_length)
{
	if (packet_length < 2U || packet[0] != SHAPES_PROTOCOL_VERSION) {
		send_nack(0U, packet_length >= 1U ? SHAPES_NACK_VERSION : SHAPES_NACK_FRAME, 0U);
		return;
	}
	switch (packet[1]) {
	case SHAPES_PACKET_START:
		handle_start(packet, packet_length);
		break;
	case SHAPES_PACKET_DATA:
		handle_data(packet, packet_length);
		break;
	case SHAPES_PACKET_ABORT:
		if (packet_length == 6U && g_session.active &&
		    sys_get_le32(&packet[2]) == g_session.id) {
			send_nack(g_session.id, SHAPES_NACK_ABORTED, g_session.next_sequence);
			reset_session();
		}
		break;
	default:
		send_nack(g_session.active ? g_session.id : 0U, SHAPES_NACK_FRAME,
			  g_session.next_sequence);
		break;
	}
}

static void process_byte(uint8_t byte)
{
	if (byte == 0U) {
		if (!g_drop_until_delimiter && g_encoded_length > 0U) {
			uint8_t decoded[SHAPES_MAX_PACKET_BYTES];
			size_t decoded_length = cobs_decode(g_encoded_packet, g_encoded_length, decoded,
						     sizeof(decoded));

			if (decoded_length == 0U) {
				send_nack(g_session.active ? g_session.id : 0U, SHAPES_NACK_FRAME,
					  g_session.next_sequence);
			} else {
				handle_packet(decoded, decoded_length);
			}
		}
		g_encoded_length = 0U;
		g_drop_until_delimiter = false;
		return;
	}

	if (!g_session.active && g_encoded_length == 4U &&
	    memcmp(g_encoded_packet, "TST0", 4U) == 0 && (byte == '\r' || byte == '\n')) {
		g_encoded_length = 0U;
		if (g_self_test != NULL) {
			g_self_test();
		}
		return;
	}
	if (g_drop_until_delimiter) {
		return;
	}
	if (g_encoded_length >= sizeof(g_encoded_packet)) {
		g_drop_until_delimiter = true;
		return;
	}
	g_encoded_packet[g_encoded_length++] = byte;
}

static void uart_rx_isr(const struct device *uart, void *user_data)
{
	uint8_t fifo[64];

	ARG_UNUSED(user_data);
	while (uart_irq_update(uart) != 0 && uart_irq_rx_ready(uart)) {
		int received = uart_fifo_read(uart, fifo, sizeof(fifo));
		uint32_t stored;

		if (received <= 0) {
			break;
		}
		stored = ring_buf_put(&g_rx_ring, fifo, (uint32_t)received);
		g_rx_dropped += (uint32_t)received - stored;
		if (stored > 0U) {
			k_sem_give(&g_rx_ready);
		}
	}
}

int shapes_uart_transport_init(const struct device *uart, uint8_t *image_buffer,
			       size_t image_buffer_size, shapes_uart_self_test_fn self_test)
{
	if (uart == NULL || image_buffer == NULL || image_buffer_size != SHAPES_IMAGE_BYTES ||
	    !device_is_ready(uart)) {
		return -EINVAL;
	}
	g_uart = uart;
	g_image_buffer = image_buffer;
	g_self_test = self_test;
	reset_session();
	uart_irq_callback_user_data_set(g_uart, uart_rx_isr, NULL);
	uart_irq_rx_enable(g_uart);
	return 0;
}

void shapes_uart_transport_run(void)
{
	while (true) {
		uint8_t bytes[64];
		uint32_t count = ring_buf_get(&g_rx_ring, bytes, sizeof(bytes));

		for (uint32_t index = 0U; index < count; ++index) {
			process_byte(bytes[index]);
		}
		if (g_rx_dropped != g_rx_dropped_seen) {
			g_rx_dropped_seen = g_rx_dropped;
			if (g_session.active) {
				send_nack(g_session.id, SHAPES_NACK_FRAME, g_session.next_sequence);
				reset_session();
			}
			g_encoded_length = 0U;
			g_drop_until_delimiter = true;
		}
		if (g_session.active && k_uptime_get() >= g_session.deadline_ms) {
			send_nack(g_session.id, SHAPES_NACK_TIMEOUT, g_session.next_sequence);
			reset_session();
		}
		if (count == 0U) {
			(void)k_sem_take(&g_rx_ready, K_MSEC(20));
		}
	}
}
```

## src/stm32n6_external_flash.c
```c
#include <errno.h>
#include <string.h>

#include <zephyr/logging/log.h>
#include <zephyr/kernel.h>
#include <zephyr/sys/util.h>

#define USE_HAL_DRIVER
#include "stm32n6xx_hal.h"

#include "stm32n6570_discovery_xspi.h"
#include "stm32n6_external_flash.h"

LOG_MODULE_REGISTER(stm32n6_external_flash, LOG_LEVEL_INF);

static bool external_flash_ready;
static bool external_flash_mmap_ready;
static bool external_flash_write_active;
K_MUTEX_DEFINE(external_flash_mutex);

/* Zephyr owns XSPI1 PSRAM for camera and LTDC buffers.  The NPU only needs
 * XSPI2 NOR, so do not reconfigure the live PSRAM controller from the BSP. */
#define STM32N6_EXTERNAL_FLASH_INIT_PSRAM 0

static uint32_t stm32n6_fnv1a32(const uint8_t *data, size_t len)
{
	uint32_t hash = 2166136261u;
	size_t i;

	for (i = 0U; i < len; ++i) {
		hash ^= data[i];
		hash *= 16777619u;
	}

	return hash;
}

static int stm32n6_external_flash_ensure_ready(void)
{
	if (external_flash_ready) {
		return 0;
	}
	if (IS_ENABLED(CONFIG_XIP)) {
		/* XIP fetches instructions through this same memory-mapped XSPI2
		 * session; force-resetting it here (as init() does) hangs the CPU. */
		return -ENOTSUP;
	}

	return stm32n6_external_flash_init();
}

int stm32n6_external_flash_init(void)
{
	BSP_XSPI_NOR_Init_t flash = {
		.InterfaceMode = MX66UW1G45G_OPI_MODE,
		.TransferRate = MX66UW1G45G_DTR_TRANSFER,
	};
	int rc;

	LOG_DBG("external flash init begin");

	/* MCUboot (RAM_LOAD) hands off with the XSPI2 peripheral still busy
	 * servicing the memory-mapped session it used to copy this image out
	 * of flash. HAL_XSPI_Init() (called from MX_XSPI_NOR_Init) waits on
	 * the controller's BUSY flag before it can reconfigure anything, and
	 * that flag never clears on its own -- it just times out after ~5s,
	 * matching the observed BSP_ERROR_PERIPH_FAILURE (-4). Disabling
	 * memory-mapped mode first does not help here because hxspi_nor[0]
	 * is not populated yet (Init() has not run), so that HAL call is a
	 * no-op on an empty handle. Force-reset the XSPI2 peripheral itself
	 * at the RCC level instead -- this clears BUSY unconditionally,
	 * independent of HAL handle state.
	 */
	__HAL_RCC_XSPI2_FORCE_RESET();
	__HAL_RCC_XSPI2_RELEASE_RESET();

#if STM32N6_EXTERNAL_FLASH_INIT_PSRAM
	rc = BSP_XSPI_RAM_Init(0);
	if (rc != BSP_ERROR_NONE) {
		LOG_ERR("BSP_XSPI_RAM_Init failed: %d", rc);
		return rc;
	}

	rc = BSP_XSPI_RAM_EnableMemoryMappedMode(0);
	if (rc != BSP_ERROR_NONE) {
		LOG_ERR("BSP_XSPI_RAM_EnableMemoryMappedMode failed: %d", rc);
		return rc;
	}
#endif

	rc = BSP_XSPI_NOR_Init(0, &flash);
	if (rc != BSP_ERROR_NONE) {
		LOG_ERR("BSP_XSPI_NOR_Init failed: %d", rc);
		return rc;
	}

	rc = BSP_XSPI_NOR_EnableMemoryMappedMode(0);
	if (rc != BSP_ERROR_NONE) {
		LOG_ERR("BSP_XSPI_NOR_EnableMemoryMappedMode failed: %d", rc);
		return rc;
	}

	LOG_DBG("external NOR ready in SPI STR memory-mapped mode");
	external_flash_ready = true;
	external_flash_mmap_ready = true;
	return 0;
}

int stm32n6_external_flash_read(uint32_t abs_addr, uint8_t *buf, size_t len)
{
	uint32_t offset;
	int rc;

	if (buf == NULL || len == 0U) {
		return -EINVAL;
	}

	if (abs_addr < STM32N6_NOR_BASE_ADDR) {
		return -EINVAL;
	}

	rc = stm32n6_external_flash_ensure_ready();
	if (rc < 0) {
		return rc;
	}

	if (external_flash_mmap_ready) {
		memcpy(buf, (const void *)(uintptr_t)abs_addr, len);
		return 0;
	}

	offset = abs_addr - STM32N6_NOR_BASE_ADDR;
	rc = BSP_XSPI_NOR_Read(0, buf, offset, (uint32_t)len);
	if (rc != BSP_ERROR_NONE) {
		LOG_ERR("BSP_XSPI_NOR_Read failed: %d offset=0x%08x len=%u",
			rc, (unsigned int)offset, (unsigned int)len);
		return rc;
	}

	return 0;
}

int stm32n6_external_flash_begin_write(void)
{
	int rc;

	k_mutex_lock(&external_flash_mutex, K_FOREVER);
	if (external_flash_write_active) {
		k_mutex_unlock(&external_flash_mutex);
		return -EBUSY;
	}
	rc = stm32n6_external_flash_ensure_ready();
	if (rc != 0) {
		k_mutex_unlock(&external_flash_mutex);
		return rc;
	}
	if (external_flash_mmap_ready) {
		rc = BSP_XSPI_NOR_DisableMemoryMappedMode(0);
		if (rc != BSP_ERROR_NONE) {
			LOG_ERR("BSP_XSPI_NOR_DisableMemoryMappedMode failed: %d", rc);
			k_mutex_unlock(&external_flash_mutex);
			return rc;
		}
		external_flash_mmap_ready = false;
	}
	external_flash_write_active = true;
	return 0;
}

int stm32n6_external_flash_erase_64k(uint32_t abs_addr)
{
	int rc;

	if (!external_flash_write_active || abs_addr < STM32N6_NOR_BASE_ADDR ||
	    ((abs_addr - STM32N6_NOR_BASE_ADDR) % STM32N6_NOR_TEST_BLOCK_LEN) != 0U) {
		return -EINVAL;
	}
	rc = BSP_XSPI_NOR_Erase_Block(0, abs_addr - STM32N6_NOR_BASE_ADDR,
				      BSP_XSPI_NOR_ERASE_64K);
	if (rc != BSP_ERROR_NONE) {
		LOG_ERR("BSP_XSPI_NOR_Erase_Block failed: %d address=0x%08x", rc,
			(unsigned int)abs_addr);
	}
	return rc;
}

int stm32n6_external_flash_write(uint32_t abs_addr, const uint8_t *buf, size_t len)
{
	int rc;

	if (!external_flash_write_active || buf == NULL || len == 0U ||
	    abs_addr < STM32N6_NOR_BASE_ADDR || len > UINT32_MAX) {
		return -EINVAL;
	}
	rc = BSP_XSPI_NOR_Write(0, buf, abs_addr - STM32N6_NOR_BASE_ADDR, (uint32_t)len);
	if (rc != BSP_ERROR_NONE) {
		LOG_ERR("BSP_XSPI_NOR_Write failed: %d address=0x%08x length=%u", rc,
			(unsigned int)abs_addr, (unsigned int)len);
	}
	return rc;
}

int stm32n6_external_flash_read_indirect(uint32_t abs_addr, uint8_t *buf, size_t len)
{
	int rc;

	if (!external_flash_write_active || buf == NULL || len == 0U ||
	    abs_addr < STM32N6_NOR_BASE_ADDR || len > UINT32_MAX) {
		return -EINVAL;
	}
	rc = BSP_XSPI_NOR_Read(0, buf, abs_addr - STM32N6_NOR_BASE_ADDR, (uint32_t)len);
	return rc == BSP_ERROR_NONE ? 0 : rc;
}

int stm32n6_external_flash_end_write(void)
{
	int rc = 0;

	if (!external_flash_write_active) {
		return -EINVAL;
	}
	rc = BSP_XSPI_NOR_EnableMemoryMappedMode(0);
	if (rc != BSP_ERROR_NONE) {
		LOG_ERR("BSP_XSPI_NOR_EnableMemoryMappedMode failed: %d", rc);
	} else {
		external_flash_mmap_ready = true;
	}
	external_flash_write_active = false;
	k_mutex_unlock(&external_flash_mutex);
	return rc;
}

int stm32n6_external_flash_nor_test(struct stm32n6_nor_test_result *result)
{
	uint8_t tx[STM32N6_NOR_TEST_DATA_LEN];
	uint8_t rx[STM32N6_NOR_TEST_DATA_LEN];
	BSP_XSPI_NOR_Diag_t diag;
	uint32_t offset;
	uint32_t i;
	int rc;

	if (result == NULL) {
		return -EINVAL;
	}

	memset(result, 0, sizeof(*result));
	result->abs_addr = STM32N6_NOR_TEST_ABS_ADDR;
	result->offset = STM32N6_NOR_TEST_ABS_ADDR - STM32N6_NOR_BASE_ADDR;
	result->size = STM32N6_NOR_TEST_DATA_LEN;
	result->first_bad_offset = UINT32_MAX;

	for (i = 0U; i < STM32N6_NOR_TEST_DATA_LEN; ++i) {
		tx[i] = (uint8_t)((i * 37U) + 11U);
	}
	result->expected_crc32 = stm32n6_fnv1a32(tx, sizeof(tx));

	rc = stm32n6_external_flash_ensure_ready();
	if (rc < 0) {
		result->erase_rc = rc;
		return rc;
	}

	if (external_flash_mmap_ready) {
		return -EBUSY;
	}

	offset = result->offset;
	rc = BSP_XSPI_NOR_TestIO(0, offset, BSP_XSPI_NOR_ERASE_64K, tx, rx, sizeof(tx), &diag);
	result->erase_rc = rc;
	result->auto_poll_rc = diag.auto_poll_rc;
	result->write_enable_erase_rc = diag.write_enable_erase_rc;
	result->block_erase_rc = diag.block_erase_rc;
	result->auto_poll_after_erase_rc = diag.auto_poll_after_erase_rc;
	result->write_enable_program_rc = diag.write_enable_program_rc;
	result->page_program_rc = diag.page_program_rc;
	result->auto_poll_after_program_rc = diag.auto_poll_after_program_rc;
	result->direct_read_rc = diag.read_rc;
	if (rc != BSP_ERROR_NONE) {
		return rc;
	}
	result->write_rc = diag.page_program_rc == MX66UW1G45G_OK ? BSP_ERROR_NONE : BSP_ERROR_COMPONENT_FAILURE;
	result->read_rc = diag.read_rc == MX66UW1G45G_OK ? BSP_ERROR_NONE : BSP_ERROR_COMPONENT_FAILURE;

	result->actual_crc32 = stm32n6_fnv1a32(rx, sizeof(rx));

	for (i = 0U; i < STM32N6_NOR_TEST_DATA_LEN; ++i) {
		if (rx[i] != tx[i]) {
			++result->mismatch_count;
			if (result->first_bad_offset == UINT32_MAX) {
				result->first_bad_offset = i;
			}
		}
	}

	if (result->first_bad_offset == UINT32_MAX) {
		result->first_bad_offset = 0U;
	}

	return (result->mismatch_count == 0U) ? 0 : -EIO;
}

/* BSP_XSPI_NOR_DisableMemoryMappedMode() -> HAL_XSPI_Abort() references this
 * even though our XSPI2 NOR usage is polling-only (no DMA configured). */
__weak HAL_StatusTypeDef HAL_DMA_Abort(DMA_HandleTypeDef *const hdma)
{
	ARG_UNUSED(hdma);
	return HAL_OK;
}
```

## src/stm32n6_npu_preinit.c
```c
#include <stdbool.h>

#include <zephyr/kernel.h>
#include <zephyr/logging/log.h>

#define USE_HAL_DRIVER
#include "stm32n6xx_hal.h"

#include "stm32n6_external_flash.h"

LOG_MODULE_REGISTER(stm32n6_npu_preinit, LOG_LEVEL_INF);

/* The N6 clock and RAM gates need to settle before the next dependent access. */
#define PREINIT_TRACE(message) \
	do { \
		LOG_DBG("%s", message); \
	} while (0)

static bool g_preinit_done;
static bool g_xspi_preinit_done;

/* Required by the ST NPU runtime before HAL_CACHEAXI_Init(). */
void npu_cache_enable_clocks_and_reset(void)
{
	__HAL_RCC_CACHEAXIRAM_MEM_CLK_ENABLE();
	__HAL_RCC_CACHEAXI_CLK_ENABLE();
	__HAL_RCC_CACHEAXI_FORCE_RESET();
	__HAL_RCC_CACHEAXI_RELEASE_RESET();
}

static uint32_t get_risaf_max_addr(RISAF_TypeDef *risaf)
{
	if ((risaf == RISAF2_S) || (risaf == RISAF2_NS)) {
		return RISAF2_LIMIT_ADDRESS_SPACE_SIZE;
	}
	if ((risaf == RISAF3_S) || (risaf == RISAF3_NS)) {
		return RISAF3_LIMIT_ADDRESS_SPACE_SIZE;
	}
	if ((risaf == RISAF4_S) || (risaf == RISAF4_NS)) {
		return RISAF4_LIMIT_ADDRESS_SPACE_SIZE;
	}
	if ((risaf == RISAF5_S) || (risaf == RISAF5_NS)) {
		return RISAF5_LIMIT_ADDRESS_SPACE_SIZE;
	}
	if ((risaf == RISAF6_S) || (risaf == RISAF6_NS)) {
		return RISAF6_LIMIT_ADDRESS_SPACE_SIZE;
	}
	if ((risaf == RISAF7_S) || (risaf == RISAF7_NS)) {
		return RISAF7_LIMIT_ADDRESS_SPACE_SIZE;
	}
	if ((risaf == RISAF8_S) || (risaf == RISAF8_NS)) {
		return RISAF8_LIMIT_ADDRESS_SPACE_SIZE;
	}
	if ((risaf == RISAF11_S) || (risaf == RISAF11_NS)) {
		return RISAF11_LIMIT_ADDRESS_SPACE_SIZE;
	}
	if ((risaf == RISAF12_S) || (risaf == RISAF12_NS)) {
		return RISAF12_LIMIT_ADDRESS_SPACE_SIZE;
	}
	if ((risaf == RISAF15_S) || (risaf == RISAF15_NS)) {
		return RISAF15_LIMIT_ADDRESS_SPACE_SIZE;
	}
	return 0U;
}

static void set_risaf_default(RISAF_TypeDef *risaf)
{
	RISAF_BaseRegionConfig_t risaf_conf = {0};

	risaf_conf.StartAddress = 0x0;
	risaf_conf.EndAddress = get_risaf_max_addr(risaf);
	risaf_conf.Filtering = RISAF_FILTER_ENABLE;
	risaf_conf.PrivWhitelist = RIF_CID_NONE;
	risaf_conf.ReadWhitelist = RIF_CID_MASK;
	risaf_conf.WriteWhitelist = RIF_CID_MASK;

	risaf_conf.Secure = RIF_ATTRIBUTE_SEC;
	HAL_RIF_RISAF_ConfigBaseRegion(risaf, 0, &risaf_conf);

	risaf_conf.Secure = RIF_ATTRIBUTE_NSEC;
	HAL_RIF_RISAF_ConfigBaseRegion(risaf, 1, &risaf_conf);
}

static void preinit_common_clocks_and_memory(void)
{
	LOG_DBG("pre-init: clocks");
	__HAL_RCC_SYSCFG_CLK_ENABLE();
	__HAL_RCC_CRC_CLK_ENABLE();
	__HAL_RCC_CACHEAXI_CLK_ENABLE();
	__HAL_RCC_XSPIM_CLK_ENABLE();
	__HAL_RCC_XSPIPHYCOMP_CLK_ENABLE();
	__HAL_RCC_XSPIPHYCOMP_CLK_SLEEP_ENABLE();
	__HAL_RCC_XSPI2_CLK_ENABLE();
	__HAL_RCC_RIFSC_CLK_ENABLE();
	__HAL_RCC_RISAF_CLK_ENABLE();
	__HAL_RCC_IAC_CLK_ENABLE();
	__HAL_RCC_RIFSC_CLK_SLEEP_ENABLE();
	__HAL_RCC_RISAF_CLK_SLEEP_ENABLE();
	__HAL_RCC_IAC_CLK_SLEEP_ENABLE();
	__HAL_RCC_XSPIM_CLK_SLEEP_ENABLE();
	__HAL_RCC_XSPI2_CLK_SLEEP_ENABLE();
	__HAL_RCC_CACHEAXI_CLK_SLEEP_ENABLE();
	__HAL_RCC_NPU_CLK_SLEEP_ENABLE();
	__HAL_RCC_AXISRAM3_MEM_CLK_SLEEP_ENABLE();
	__HAL_RCC_AXISRAM4_MEM_CLK_SLEEP_ENABLE();
	__HAL_RCC_AXISRAM5_MEM_CLK_SLEEP_ENABLE();
	__HAL_RCC_AXISRAM6_MEM_CLK_SLEEP_ENABLE();
	__HAL_RCC_CACHEAXIRAM_MEM_CLK_SLEEP_ENABLE();

	LOG_DBG("pre-init: memenr");
	RCC->MEMENR |= RCC_MEMENR_AXISRAM3EN | RCC_MEMENR_AXISRAM4EN |
		       RCC_MEMENR_AXISRAM5EN | RCC_MEMENR_AXISRAM6EN;
	RCC->MEMENR |= RCC_MEMENR_CACHEAXIRAMEN;

	LOG_DBG("pre-init: ramcfg");
	RAMCFG_SRAM2_AXI->CR &= ~RAMCFG_CR_SRAMSD;
	RAMCFG_SRAM3_AXI->CR &= ~RAMCFG_CR_SRAMSD;
	RAMCFG_SRAM4_AXI->CR &= ~RAMCFG_CR_SRAMSD;
	RAMCFG_SRAM5_AXI->CR &= ~RAMCFG_CR_SRAMSD;
	RAMCFG_SRAM6_AXI->CR &= ~RAMCFG_CR_SRAMSD;

	LOG_DBG("pre-init: memsysctl");
	MEMSYSCTL->MSCR |= MEMSYSCTL_MSCR_DCACTIVE_Msk | MEMSYSCTL_MSCR_ICACTIVE_Msk;
}

static void preinit_common_risaf(void)
{
	LOG_DBG("pre-init: risaf defaults");
	LOG_DBG("pre-init: risaf2");
	set_risaf_default(RISAF2_S);
	LOG_DBG("pre-init: risaf2 done");
	LOG_DBG("pre-init: risaf3");
	set_risaf_default(RISAF3_S);
	LOG_DBG("pre-init: risaf3 done");
	LOG_DBG("pre-init: risaf4");
	set_risaf_default(RISAF4_S);
	LOG_DBG("pre-init: risaf4 done");
	LOG_DBG("pre-init: risaf5");
	set_risaf_default(RISAF5_S);
	LOG_DBG("pre-init: risaf5 done");
	LOG_DBG("pre-init: risaf6");
	set_risaf_default(RISAF6_S);
	LOG_DBG("pre-init: risaf6 done");
	LOG_DBG("pre-init: risaf7");
	set_risaf_default(RISAF7_S);
	LOG_DBG("pre-init: risaf7 done");
	LOG_DBG("pre-init: risaf8");
	set_risaf_default(RISAF8_S);
	LOG_DBG("pre-init: risaf8 done");
	LOG_DBG("pre-init: risaf11/12 skipped");
}

int stm32n6_xspi_pre_init(void)
{
	if (g_xspi_preinit_done) {
		return 0;
	}

	LOG_DBG("xspi-pre-init begin");
	preinit_common_clocks_and_memory();
	LOG_DBG("xspi-pre-init: risaf skipped");

	LOG_DBG("xspi-pre-init: risc xspi");
	HAL_RIF_RISC_SetSlaveSecureAttributes(RIF_RISC_PERIPH_INDEX_XSPI2,
					      RIF_ATTRIBUTE_PRIV | RIF_ATTRIBUTE_SEC);
	LOG_DBG("xspi-pre-init: risc xspi2 done");

	HAL_RIF_RISC_SetSlaveSecureAttributes(RIF_RISC_PERIPH_INDEX_XSPIM,
					      RIF_ATTRIBUTE_PRIV | RIF_ATTRIBUTE_SEC);
	LOG_DBG("xspi-pre-init: risc xspim done");

	HAL_RIF_RISC_SetSlaveSecureAttributes(RIF_RCC_PERIPH_INDEX_CACHEAXIRAM,
					      RIF_ATTRIBUTE_SEC);
	LOG_DBG("xspi-pre-init: risc cacheaxiram done");

	LOG_DBG("xspi-pre-init: external flash");
	if (stm32n6_external_flash_init() != 0) {
		LOG_ERR("xspi-pre-init: external flash init failed");
		return -1;
	}

	g_xspi_preinit_done = true;
	LOG_DBG("xspi-pre-init done");
	return 0;
}

int stm32n6_npu_pre_init(void)
{
	RIMC_MasterConfig_t master_conf = {0};

	if (g_preinit_done) {
		return 0;
	}

	/* This runs before camera/LTDC DMA starts and establishes the NPU access domain. */
	PREINIT_TRACE("pre-init: NPU, xSPI, and AXISRAM access setup");
	preinit_common_clocks_and_memory();

	PREINIT_TRACE("pre-init: reset NPU");
	__HAL_RCC_NPU_CLK_ENABLE();
	__HAL_RCC_NPU_FORCE_RESET();
	__HAL_RCC_NPU_RELEASE_RESET();

	PREINIT_TRACE("pre-init: configure NPU master access");
	master_conf.MasterCID = RIF_CID_1;
	master_conf.SecPriv = RIF_ATTRIBUTE_SEC | RIF_ATTRIBUTE_PRIV;
	HAL_RIF_RIMC_ConfigMasterAttributes(RIF_MASTER_INDEX_NPU, &master_conf);

	PREINIT_TRACE("pre-init: configure NPU and xSPI peripherals");
	HAL_RIF_RISC_SetSlaveSecureAttributes(RIF_RISC_PERIPH_INDEX_NPU,
					      RIF_ATTRIBUTE_PRIV | RIF_ATTRIBUTE_SEC);
	HAL_RIF_RISC_SetSlaveSecureAttributes(RIF_RISC_PERIPH_INDEX_XSPI2,
					      RIF_ATTRIBUTE_PRIV | RIF_ATTRIBUTE_SEC);
	HAL_RIF_RISC_SetSlaveSecureAttributes(RIF_RISC_PERIPH_INDEX_XSPIM,
					      RIF_ATTRIBUTE_PRIV | RIF_ATTRIBUTE_SEC);
	HAL_RIF_RISC_SetSlaveSecureAttributes(RIF_RCC_PERIPH_INDEX_CACHEAXIRAM,
					      RIF_ATTRIBUTE_SEC);
	HAL_RIF_RISC_SetSlaveSecureAttributes(RIF_RCC_PERIPH_INDEX_NPURAM0,
					      RIF_ATTRIBUTE_SEC);
	HAL_RIF_RISC_SetSlaveSecureAttributes(RIF_RCC_PERIPH_INDEX_NPURAM1,
					      RIF_ATTRIBUTE_SEC);
	HAL_RIF_RISC_SetSlaveSecureAttributes(RIF_RCC_PERIPH_INDEX_NPURAM2,
					      RIF_ATTRIBUTE_SEC);
	HAL_RIF_RISC_SetSlaveSecureAttributes(RIF_RCC_PERIPH_INDEX_NPURAM3,
					      RIF_ATTRIBUTE_SEC);

	/*
	 * The application executes directly from the xSPI2 NOR image. MCUboot has
	 * already configured the controller's memory-mapped mode; reinitializing it
	 * here would cut off instruction fetches from the running application.
	 */
	PREINIT_TRACE("pre-init: preserve MCUboot xSPI memory map");

	PREINIT_TRACE("pre-init: ensure sleep clocks remain available");
	PREINIT_TRACE("pre-init: enable XSPIM clock");
	__HAL_RCC_XSPIM_CLK_ENABLE();
	PREINIT_TRACE("pre-init: XSPIM clock enabled");
	PREINIT_TRACE("pre-init: enable XSPI2 clock");
	__HAL_RCC_XSPI2_CLK_ENABLE();
	PREINIT_TRACE("pre-init: XSPI2 clock enabled");
	PREINIT_TRACE("pre-init: enable XSPIM sleep clock");
	__HAL_RCC_XSPIM_CLK_SLEEP_ENABLE();
	PREINIT_TRACE("pre-init: XSPIM sleep clock enabled");
	PREINIT_TRACE("pre-init: enable XSPIPHYCOMP sleep clock");
	__HAL_RCC_XSPIPHYCOMP_CLK_SLEEP_ENABLE();
	PREINIT_TRACE("pre-init: XSPIPHYCOMP sleep clock enabled");
	PREINIT_TRACE("pre-init: enable XSPI2 sleep clock");
	__HAL_RCC_XSPI2_CLK_SLEEP_ENABLE();
	PREINIT_TRACE("pre-init: XSPI2 sleep clock enabled");

	/* Generated YuNet buffers occupy AXISRAM3 through AXISRAM6. */
	PREINIT_TRACE("pre-init: enable AXISRAM3-6 and CACHEAXIRAM");
	RCC->MEMENR |= RCC_MEMENR_AXISRAM3EN | RCC_MEMENR_AXISRAM4EN |
		       RCC_MEMENR_AXISRAM5EN | RCC_MEMENR_AXISRAM6EN |
		       RCC_MEMENR_CACHEAXIRAMEN;
	PREINIT_TRACE("pre-init: AXISRAM banks enabled");
	PREINIT_TRACE("pre-init: wake AXISRAM3");
	RAMCFG_SRAM3_AXI->CR &= ~RAMCFG_CR_SRAMSD;
	PREINIT_TRACE("pre-init: wake AXISRAM4");
	RAMCFG_SRAM4_AXI->CR &= ~RAMCFG_CR_SRAMSD;
	PREINIT_TRACE("pre-init: wake AXISRAM5");
	RAMCFG_SRAM5_AXI->CR &= ~RAMCFG_CR_SRAMSD;
	PREINIT_TRACE("pre-init: wake AXISRAM6");
	RAMCFG_SRAM6_AXI->CR &= ~RAMCFG_CR_SRAMSD;
	PREINIT_TRACE("pre-init: AXISRAM3-6 awake");
	PREINIT_TRACE("pre-init: enable CACHEAXI");
	MEMSYSCTL->MSCR |= MEMSYSCTL_MSCR_DCACTIVE_Msk | MEMSYSCTL_MSCR_ICACTIVE_Msk;
	PREINIT_TRACE("pre-init: CACHEAXI enabled");

	g_preinit_done = true;
	PREINIT_TRACE("pre-init done");

	return 0;
}
```
